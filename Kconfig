## Kconfig
```kconfig
menu "librespot-cpp (Spotify Connect engine)"

    config LIBRESPOT_CODEC_MP3
        bool "MP3 codec (episodios de podcast)"
        default y

endmenu
```

## targets/esp32/sdkconfig.defaults
```kconfig
# Defaults assume Octal SPI PSRAM (true for most ESP32-S3 boards with a
# built-in display, including the JC3248W535) - NOT verified against that
# board's actual datasheet/module marking here - if the board boots into a
# crash loop or garbled serial output, this is the first thing to check
# (`idf.py menuconfig` -> Component config -> ESP PSRAM -> switch
# Octal/Quad mode, or PSRAM type Auto-detect). Mirrors the equivalent
# settings in our other ESP32 project (cspot/sdkconfig.defaults), same
# physical board.
CONFIG_IDF_TARGET="esp32s3"

# bell::Task (external/bell/main/utilities/include/BellTask.h - via
# bell::utils::Task on this branch) allocates every task's stack from
# PSRAM by default (MALLOC_CAP_SPIRAM) - required, not optional, or task
# creation fails.
CONFIG_SPIRAM=y
CONFIG_SPIRAM_MODE_OCT=y
CONFIG_SPIRAM_SPEED_80M=y

# CSpotTask (targets/esp32/main/main.cpp) does WiFi connect + ZeroConf
# pairing + Session bring-up on its own 32KB task, but app_main() itself
# still does NVS/SPIFFS init + WiFi connect (example_connect()) before
# spawning it - the default 3584 bytes is tight for that, bumped
# proactively (our other project needed this same bump for a similar,
# heavier pattern - WiFi+mDNS+HTTP+TLS all in app_main there).
CONFIG_ESP_MAIN_TASK_STACK_SIZE=8192

# api/ApConnection.cpp, bell's TLSSocket.cpp/DigestCrypto.cpp, etc. throw
# std::invalid_argument/std::runtime_error throughout - ESP-IDF C++ builds
# have exceptions off by default.
CONFIG_COMPILER_CXX_EXCEPTIONS=y

# JC3248W535 has 16MB flash.
CONFIG_ESPTOOLPY_FLASHSIZE_16MB=y

# Already present: targets/esp32/partitions.csv (2MB app partition - fits
# today's build with room to spare, 17% free per the last idf.py build;
# revisit once Stage D's real playback pipeline is built out, same flash-
# margin history our other project already lived through once).
CONFIG_PARTITION_TABLE_CUSTOM=y
CONFIG_PARTITION_TABLE_CUSTOM_FILENAME="partitions.csv"

# mbedTLS TLS buffers to PSRAM instead of internal DRAM.
CONFIG_MBEDTLS_EXTERNAL_MEM_ALLOC=y

# Prefer PSRAM for Wi-Fi/lwIP allocations, and lower the "always internal"
# malloc() threshold from 16KB to 512B so most small allocations can go to
# PSRAM too. Both fall back to internal memory automatically if PSRAM
# allocation fails.
CONFIG_SPIRAM_TRY_ALLOCATE_WIFI_LWIP=y
CONFIG_SPIRAM_MALLOC_ALWAYSINTERNAL=512

# Hardware AES needs DMA descriptors that must live in internal DRAM (no
# PSRAM alternative on this SoC) - found failing allocation under
# concurrent TLS load on our other project's identical board. cspot-orig's
# own api/ (ApConnection + DealerClient + SpClient + CDNDataStream) opens
# a comparable set of concurrent TLS-ish connections, so this is a real
# carried-over risk, not speculative. No speed cost at 240MHz per this
# option's own Kconfig help text.
CONFIG_MBEDTLS_HARDWARE_AES=n
CONFIG_MBEDTLS_GCM_SUPPORT_NON_AES_CIPHER=n
CONFIG_MBEDTLS_AES_USE_INTERRUPT=n

# Smaller "common certificates" bundle (~50% smaller, ~99% coverage per
# ESP-IDF's own Kconfig help text) instead of the full root CA bundle -
# strictly beneficial here, nothing exotic needed to talk to Spotify's own
# servers.
CONFIG_MBEDTLS_CERTIFICATE_BUNDLE_DEFAULT_CMN=y

# Our other project found the default of 10 too tight for ~5 persistent
# TLS/TCP connections (AP, Dealer WS, connect-state PUT, CDN, etc.) plus
# ~3 reserved by the zeroconf httpd - api/'s connection footprint here is
# comparable.
CONFIG_LWIP_MAX_SOCKETS=16

# Enables uxTaskGetSystemState() so per-task stack high-water marks can
# actually be measured instead of guessed. Cheap: a few tens of bytes of
# TCB overhead per task.
CONFIG_FREERTOS_USE_TRACE_FACILITY=y
```
