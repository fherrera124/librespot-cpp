## extras/esp32/main/Kconfig.projbuild
```kconfig
menu "librespot-cpp ESP32 example"

    config CSPOT_DEVICE_NAME
        string "Device name"
        default "librespot-cpp ESP32"
        help
            Name shown in the Spotify app's device picker.

    choice CSPOT_QUALITY
        prompt "Streaming bitrate"
        default CSPOT_QUALITY_160
        config CSPOT_QUALITY_320
            bool "320 kbps"
        config CSPOT_QUALITY_160
            bool "160 kbps"
        config CSPOT_QUALITY_96
            bool "96 kbps"
    endchoice

    menu "I2S pinout"
        # Defaults match this repo's own feature/esp32-port branch
        # (targets/esp32/main/main.cpp) for the same physical board
        # (JC3248W535, onboard NS4168 mono class-D amp) - change these if
        # targeting different hardware.
        config CSPOT_I2S_BCLK_GPIO
            int "BCLK GPIO"
            default 42

        config CSPOT_I2S_WS_GPIO
            int "WS (LRCLK) GPIO"
            default 2

        config CSPOT_I2S_DOUT_GPIO
            int "DOUT GPIO"
            default 41

        config CSPOT_I2S_MCLK_GPIO
            int "MCLK GPIO (-1 if unused)"
            default 0
            help
                GPIO0 is a boot-strap pin - safe to drive once the board has
                already finished booting, not before. Set -1 if your DAC/amp
                doesn't need MCLK.
    endmenu

endmenu
```

## targets/esp32/main/Kconfig.projbuild
```kconfig
menu "CSPOT Configuration"

    config CSPOT_DEVICE_NAME
        string "CSpot Device Name"
        default "CSpot-ESP32"
        help
            Define the name of the cspot device (will be visible to the client).

    choice CSPOT_QUALITY
        prompt "Audio Quality (BPS)"
        default CSPOT_QUALITY_320
        help
            Audio quality (not used currently)
        config CSPOT_QUALITY_320
            bool "320 bps"
        config CSPOT_QUALITY_160
            bool "160 bps"
        config CSPOT_QUALITY_96
            bool "96 bps"
    endchoice

    config CSPOT_I2S_BCLK_GPIO
        int "I2S BCK (bit clock) GPIO"
        default 42
        help
            Defaults match the JC3248W535's onboard NS4168 wiring. Change
            to match your own DAC/amp (e.g. an external PCM5102 breakout).

    config CSPOT_I2S_WS_GPIO
        int "I2S LRCK (word select) GPIO"
        default 2

    config CSPOT_I2S_DOUT_GPIO
        int "I2S DIN (data) GPIO"
        default 41

    config CSPOT_I2S_MCLK_GPIO
        int "I2S MCLK GPIO (-1 if unused)"
        default 0
        help
            GPIO_NUM_0 is the JC3248W535's boot-strap pin, safe once
            running - that's what the onboard NS4168 uses. Most DACs with
            an internal PLL (e.g. PCM5102) don't need MCLK at all - set to
            -1 in that case.

    config CSPOT_I2S_MONO_OUTPUT
        bool "Downmix to mono"
        default y
        help
            Enable for mono amps. Disable for real stereo DACs (e.g. PCM5102).

    config CSPOT_NORMALISATION_ENABLED
        bool "Loudness normalization (Spotify standard, -14 LUFS)"
        default y
        help
            Applies each track's own CDN-provided gain (ITU-R BS.1770).

endmenu
```
